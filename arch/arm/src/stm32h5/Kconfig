## arch/arm/src/stm32h5/Kconfig.fdcan
```kconfig
menu "FDCAN driver configuration"
	depends on STM32H5_FDCAN

choice
	prompt "FDCAN character driver or SocketCAN support"
	default STM32H5_FDCAN_CHARDRIVER

config STM32H5_FDCAN_CHARDRIVER
	bool "STM32 FDCAN character driver support"
	select ARCH_HAVE_CAN_ERRORS
	select CAN

config STM32H5_FDCAN_SOCKET
	bool "STM32 FDCAN SocketCAN support"
	select NET_CAN_HAVE_ERRORS
	select NET_CAN_HAVE_CANFD

endchoice # FDCAN character driver or SocketCAN support

config STM32H5_FDCAN_REGDEBUG
	bool "CAN Register level debug"
	depends on DEBUG_CAN_INFO
	default n
	---help---
		Output detailed register-level CAN device debug information.
		Requires also CONFIG_DEBUG_CAN_INFO.

config STM32H5_FDCAN_QUEUE_MODE
	bool "FDCAN QUEUE mode (vs FIFO mode)"
	default n

menu "FDCAN1 device driver options"
	depends on STM32H5_FDCAN1

choice
	prompt "FDCAN1 frame format"
	default STM32H5_FDCAN1_ISO11898_1

config STM32H5_FDCAN1_ISO11898_1
	bool "ISO11898-1"
	---help---
		Enable ISO11898-1 frame format

config STM32H5_FDCAN1_NONISO_FORMAT
	bool "Non ISO"
	---help---
		Enable Non ISO, Bosch CAN FD Specification V1.0

endchoice # FDCAN1 frame format

choice
	prompt "FDCAN1 mode"
	default STM32H5_FDCAN1_CLASSIC

config STM32H5_FDCAN1_CLASSIC
	bool "Classic CAN"
	---help---
		Enable Clasic CAN mode

config STM32H5_FDCAN1_FD
	bool "CAN FD"
	depends on CAN_FD || NET_CAN_CANFD
	---help---
		Enable CAN FD mode

config STM32H5_FDCAN1_FD_BRS
	bool "CAN FD with fast bit rate switching"
	depends on CAN_FD || NET_CAN_CANFD
	---help---
		Enable CAN FD mode with fast bit rate switching mode.

endchoice # FDCAN1 mode

menu "FDCAN1 Bit Timing"

config STM32H5_FDCAN1_AUTO_BIT_TIMING
	bool "FDCAN1 Automatic Bit Timing"
	default y
	---help---
		Automatically determine FDCAN1 bit timing (nominal and data) based on bitrate.

comment "Nominal Bit Timing"

config STM32H5_FDCAN1_BITRATE
	int "FDCAN bitrate"
	default 500000
	range 0 1000000
	---help---
		FDCAN1 bitrate in bits per second.  Required if STM32H5_FDCAN1 is defined.

config STM32H5_FDCAN1_NTSEG1
	int "FDCAN1 NTSEG1 (PropSeg + PhaseSeg1)"
	default 6
	range 1 256
	depends on !STM32H5_FDCAN1_AUTO_BIT_TIMING
	---help---
		The length of the bit time is Tquanta * (SyncSeg + PropSeg + PhaseSeg1 + PhaseSeg2).

config STM32H5_FDCAN1_NTSEG2
	int "FDCAN1 NTSEG2 (PhaseSeg2)"
	default 7
	range 1 128
	depends on !STM32H5_FDCAN1_AUTO_BIT_TIMING
	---help---
		The length of the bit time is Tquanta * (SyncSeg + PropSeg + PhaseSeg1 + PhaseSeg2).

config STM32H5_FDCAN1_NSJW
	int "FDCAN1 synchronization jump width"
	default 1
	range 1 128
	depends on !STM32H5_FDCAN1_AUTO_BIT_TIMING
	---help---
		The length of the bit time is Tquanta * (SyncSeg + PropSeg + PhaseSeg1 + PhaseSeg2).

comment "Data Bit Timing"
	depends on CAN_FD && STM32H5_FDCAN1_FD_BRS

config STM32H5_FDCAN1_DBITRATE
	int "FDCAN1 data bitrate"
	default 2000000
	depends on CAN_FD && STM32H5_FDCAN1_FD_BRS
	---help---
		FDCAN1 bitrate in bits per second.  Required if operating in FD mode with bit rate switching (BRS).

config STM32H5_FDCAN1_DTSEG1
	int "FDCAN1 DTSEG1 (PropSeg + PhaseSeg1 of data phase)"
	default 4
	range 1 31
	depends on CAN_FD && STM32H5_FDCAN1_FD_BRS && !STM32H5_FDCAN1_AUTO_BIT_TIMING
	---help---
		The length of the bit time is Tquanta * (SyncSeg + PropSeg + PhaseSeg1 + PhaseSeg2).

config STM32H5_FDCAN1_DTSEG2
	int "FDCAN1 DTSEG2 (PhaseSeg2 of data phase)"
	default 4
	range 1 15
	depends on CAN_FD && STM32H5_FDCAN1_FD_BRS && !STM32H5_FDCAN1_AUTO_BIT_TIMING
	---help---
		The length of the bit time is Tquanta * (SyncSeg + PropSeg + PhaseSeg1 + PhaseSeg2).

config STM32H5_FDCAN1_DSJW
	int "FDCAN1 fast synchronization jump width"
	default 2
	range 1 15
	depends on CAN_FD && STM32H5_FDCAN1_FD_BRS && !STM32H5_FDCAN1_AUTO_BIT_TIMING
	---help---
		The duration of a synchronization jump is Tcan_clk x DSJW.

endmenu # FDCAN1 Bit Timing

config STM32H5_FDCAN1_LOOPBACK
	bool "Enable FDCAN1 loopback mode"
	default n
	---help---
		Enable the FDCAN1 local loopback mode for testing purposes.

endmenu # FDCAN1 device driver options

menu "FDCAN2 device driver options"
	depends on STM32H5_FDCAN2

choice
	prompt "FDCAN2 frame format"
	default STM32H5_FDCAN2_ISO11898_1

config STM32H5_FDCAN2_ISO11898_1
	bool "ISO11898-1"
	---help---
		Enable ISO11898-1 frame format

config STM32H5_FDCAN2_NONISO_FORMAT
	bool "Non ISO"
	---help---
		Enable Non ISO, Bosch CAN FD Specification V1.0

endchoice # FDCAN2 frame format

choice
	prompt "FDCAN2 mode"
	default STM32H5_FDCAN2_CLASSIC

config STM32H5_FDCAN2_CLASSIC
	bool "Classic CAN"
	---help---
		Enable Clasic CAN mode

config STM32H5_FDCAN2_FD
	bool "CAN FD"
	depends on CAN_FD || NET_CAN_CANFD
	---help---
		Enable CAN FD mode

config STM32H5_FDCAN2_FD_BRS
	bool "CAN FD with fast bit rate switching"
	depends on CAN_FD || NET_CAN_CANFD
	---help---
		Enable CAN FD mode with fast bit rate switching mode.

endchoice # FDCAN2 mode

menu "FDCAN2 Bit Timing"

config STM32H5_FDCAN2_AUTO_BIT_TIMING
	bool "FDCAN2 Automatic Bit Timing"
	default y
	---help---
		Automatically determine FDCAN2 bit timing (nominal and data) based on bitrate.

comment "Nominal Bit Timing"

config STM32H5_FDCAN2_BITRATE
	int "FDCAN bitrate"
	default 500000
	range 0 1000000
	---help---
		FDCAN2 bitrate in bits per second.  Required if STM32H5_FDCAN2 is defined.

config STM32H5_FDCAN2_NTSEG1
	int "FDCAN2 NTSEG1 (PropSeg + PhaseSeg1)"
	default 6
	range 1 256
	depends on !STM32H5_FDCAN2_AUTO_BIT_TIMING
	---help---
		The length of the bit time is Tquanta * (SyncSeg + PropSeg + PhaseSeg1 + PhaseSeg2).

config STM32H5_FDCAN2_NTSEG2
	int "FDCAN2 NTSEG2 (PhaseSeg2)"
	default 7
	range 1 128
	depends on !STM32H5_FDCAN2_AUTO_BIT_TIMING
	---help---
		The length of the bit time is Tquanta * (SyncSeg + PropSeg + PhaseSeg1 + PhaseSeg2).

config STM32H5_FDCAN2_NSJW
	int "FDCAN2 synchronization jump width"
	default 1
	range 1 128
	depends on !STM32H5_FDCAN2_AUTO_BIT_TIMING
	---help---
		The length of the bit time is Tquanta * (SyncSeg + PropSeg + PhaseSeg1 + PhaseSeg2).

comment "Data Bit Timing"
	depends on CAN_FD && STM32H5_FDCAN2_FD_BRS

config STM32H5_FDCAN2_DBITRATE
	int "FDCAN2 data bitrate"
	default 2000000
	depends on CAN_FD && STM32H5_FDCAN2_FD_BRS
	---help---
		FDCAN2 bitrate in bits per second.  Required if operating in FD mode with bit rate switching (BRS).

config STM32H5_FDCAN2_DTSEG1
	int "FDCAN2 DTSEG1 (PropSeg + PhaseSeg1 of data phase)"
	default 4
	range 1 31
	depends on CAN_FD && STM32H5_FDCAN2_FD_BRS && !STM32H5_FDCAN2_AUTO_BIT_TIMING
	---help---
		The length of the bit time is Tquanta * (SyncSeg + PropSeg + PhaseSeg1 + PhaseSeg2).

config STM32H5_FDCAN2_DTSEG2
	int "FDCAN2 DTSEG2 (PhaseSeg2 of data phase)"
	default 4
	range 1 15
	depends on CAN_FD && STM32H5_FDCAN2_FD_BRS && !STM32H5_FDCAN2_AUTO_BIT_TIMING
	---help---
		The length of the bit time is Tquanta * (SyncSeg + PropSeg + PhaseSeg1 + PhaseSeg2).

config STM32H5_FDCAN2_DSJW
	int "FDCAN2 fast synchronization jump width"
	default 2
	range 1 15
	depends on CAN_FD && STM32H5_FDCAN2_FD_BRS && !STM32H5_FDCAN2_AUTO_BIT_TIMING
	---help---
		The duration of a synchronization jump is Tcan_clk x DSJW.

endmenu # FDCAN2 Bit Timing

config STM32H5_FDCAN2_LOOPBACK
	bool "Enable FDCAN2 loopback mode"
	default n
	---help---
		Enable the FDCAN2 local loopback mode for testing purposes.

endmenu # FDCAN2 device driver options

endmenu # "FDCAN driver configuration"
```

## arch/arm/src/stm32h5/Kconfig.i2c
```kconfig
menu "I2C Configuration"
	depends on STM32H5_I2C

menu "Clock Selection"

choice
	depends on STM32H5_I2C1
	prompt "I2C1 Input Clock Selection"
	default STM32H5_I2C1_CLK_PCLK1

config STM32H5_I2C1_CLK_CSI
	bool "CSI"

config STM32H5_I2C1_CLK_HSI
	bool "HSI"

config STM32H5_I2C1_CLK_PCLK1
	bool "PCLK1"

config STM32H5_I2C1_CLK_PLL3R
	bool "PLL3R"

endchoice # I2C1 Input Clock Selection

choice
	depends on STM32H5_I2C2
	prompt "I2C2 Input Clock Selection"
	default STM32H5_I2C2_CLK_PCLK1

config STM32H5_I2C2_CLK_CSI
	bool "CSI"

config STM32H5_I2C2_CLK_HSI
	bool "HSI"

config STM32H5_I2C2_CLK_PCLK1
	bool "PCLK1"

config STM32H5_I2C2_CLK_PLL3R
	bool "PLL3R"

endchoice # I2C2 Input Clock Selection

choice
	depends on STM32H5_I2C3
	prompt "I2C3 Input Clock Selection"
	default STM32H5_I2C3_CLK_PCLK3

config STM32H5_I2C3_CLK_CSI
	bool "CSI"

config STM32H5_I2C3_CLK_HSI
	bool "HSI"

config STM32H5_I2C3_CLK_PCLK3
	bool "PCLK3"

config STM32H5_I2C3_CLK_PLL3R
	bool "PLL3R"

endchoice # I2C3 Input Clock Selection

choice
	depends on STM32H5_I2C4
	prompt "I2C4 Input Clock Selection"
	default STM32H5_I2C4_CLK_PCLK3

config STM32H5_I2C4_CLK_CSI
	bool "CSI"

config STM32H5_I2C4_CLK_HSI
	bool "HSI"

config STM32H5_I2C4_CLK_PCLK3
	bool "PCLK3"

config STM32H5_I2C4_CLK_PLL3R
	bool "PLL3R"

endchoice # I2C4 Input Clock Selection

endmenu # Clock Selection

menu "Rise/Fall Override"

config STM32H5_I2C1_RF_OVERRIDE
	bool "I2C1"
	default n
	depends on STM32H5_I2C1

config STM32H5_I2C2_RF_OVERRIDE
	bool "I2C2"
	default n
	depends on STM32H5_I2C2

config STM32H5_I2C3_RF_OVERRIDE
	bool "I2C3"
	default n
	depends on STM32H5_I2C3

config STM32H5_I2C4_RF_OVERRIDE
	bool "I2C4"
	default n
	depends on STM32H5_I2C4

menu "Rise/Fall Values"

config STM32H5_I2C1_RISE
	int "I2C1 Rise Time (ns)"
	range 0 1000
	default 20
	depends on STM32H5_I2C1_RF_OVERRIDE

config STM32H5_I2C1_FALL
	int "I2C1 Fall Time (ns)"
	range 0 300
	default 20
	depends on STM32H5_I2C1_RF_OVERRIDE

config STM32H5_I2C2_RISE
	int "I2C2 Rise Time (ns)"
	range 0 1000
	default 20
	depends on STM32H5_I2C2_RF_OVERRIDE

config STM32H5_I2C2_FALL
	int "I2C2 Fall Time (ns)"
	range 0 300
	default 20
	depends on STM32H5_I2C2_RF_OVERRIDE

config STM32H5_I2C3_RISE
	int "I2C3 Rise Time (ns)"
	range 0 1000
	default 20
	depends on STM32H5_I2C3_RF_OVERRIDE

config STM32H5_I2C3_FALL
	int "I2C3 Fall Time (ns)"
	range 0 300
	default 20
	depends on STM32H5_I2C3_RF_OVERRIDE

config STM32H5_I2C4_RISE
	int "I2C4 Rise Time (ns)"
	range 0 1000
	default 20
	depends on STM32H5_I2C4_RF_OVERRIDE

config STM32H5_I2C4_FALL
	int "I2C4 Fall Time (ns)"
	range 0 300
	default 20
	depends on STM32H5_I2C4_RF_OVERRIDE

endmenu # Rise/Fall Values

endmenu # Rise/Fall Override

menu "Filtering"

menu "Digital Filters"

config STM32H5_I2C1_DNF
	int "I2C1 Digital Noise Filter"
	range 0 15
	default 0
	depends on STM32H5_I2C1

config STM32H5_I2C2_DNF
	int "I2C2 Digital Noise Filter"
	range 0 15
	default 0
	depends on STM32H5_I2C2

config STM32H5_I2C3_DNF
	int "I2C3 Digital Noise Filter"
	range 0 15
	default 0
	depends on STM32H5_I2C3

config STM32H5_I2C4_DNF
	int "I2C4 Digital Noise Filter"
	range 0 15
	default 0
	depends on STM32H5_I2C4

endmenu # Digital Filters

menu "Analog Filters"

config STM32H5_I2C1_ANFOFF
	int "Turn off I2C1 Analog Filter (0=on, 1=off)"
	default 1
	range 0 1
	depends on STM32H5_I2C1

config STM32H5_I2C2_ANFOFF
	int "Turn off I2C2 Analog Filter (0=on, 1=off)"
	default 1
	range 0 1
	depends on STM32H5_I2C2

config STM32H5_I2C3_ANFOFF
	int "Turn off I2C3 Analog Filter (0=on, 1=off)"
	default 1
	range 0 1
	depends on STM32H5_I2C3

config STM32H5_I2C4_ANFOFF
	int "Turn off I2C4 Analog Filter (0=on, 1=off)"
	default 1
	range 0 1
	depends on STM32H5_I2C4

endmenu # Analog Filters

endmenu # Filtering

config STM32H5_I2C_DYNTIMEO
	bool "Use dynamic timeouts"
	default n
	depends on STM32H5_I2C

config STM32H5_I2C_DYNTIMEO_USECPERBYTE
	int "Timeout Microseconds per Byte"
	default 500
	depends on STM32H5_I2C_DYNTIMEO

config STM32H5_I2C_DYNTIMEO_STARTSTOP
	int "Timeout for Start/Stop (Milliseconds)"
	default 1000
	depends on STM32H5_I2C_DYNTIMEO

config STM32H5_I2CTIMEOSEC
	int "Timeout seconds"
	default 0
	depends on STM32H5_I2C

config STM32H5_I2CTIMEOMS
	int "Timeout Milliseconds"
	default 500
	depends on STM32H5_I2C && !STM32H5_I2C_DYNTIMEO

config STM32H5_I2CTIMEOTICKS
	int "Timeout for Done and Stop (ticks)"
	default 500
	depends on STM32H5_I2C && !STM32H5_I2C_DYNTIMEO

endmenu # "I2C Configuration"
```
