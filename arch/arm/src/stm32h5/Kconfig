## arch/arm/src/stm32h5/Kconfig
```kconfig
#
# For a description of the syntax of this configuration file,
# see the file kconfig-language.txt in the NuttX tools repository.
#

if ARCH_CHIP_STM32H5

comment "STM32H5 Configuration Options"

choice
	prompt "STM32 H5 Chip Selection"
	default ARCH_CHIP_STM32H563ZI
	depends on ARCH_CHIP_STM32H5

config ARCH_CHIP_STM32H563ZI
	bool "STM32H563ZI"
	select ARCH_CORTEXM33
	select STM32H5_STM32H5XXXX
	select STM32H5_STM32H56XXX
	select STM32H5_STM32H563XX
	select STM32H5_STM32H5X3XX
	select STM32H5_FLASH_CONFIG_I
	select STM32H5_IO_CONFIG_Z
	---help---
		STM32 H5 Cortex M33, 512 Kb FLASH, 256 Kb SRAM

endchoice # STM32 H5 Chip Selection

# Chip families:

config STM32H5_STM32H5XXXX
	bool
	default n
	select ARCH_HAVE_FPU
	select STM32H5_HAVE_ICACHE

config STM32H5_STM32H56XXX
	bool
	default n
	select STM32H5_HAVE_FDCAN1
	select STM32H5_HAVE_FDCAN2
	select STM32H5_HAVE_LPUART1
	select STM32H5_HAVE_USART1
	select STM32H5_HAVE_USART2
	select STM32H5_HAVE_USART3
	select STM32H5_HAVE_UART4
	select STM32H5_HAVE_UART5
	select STM32H5_HAVE_USART6
	select STM32H5_HAVE_UART7
	select STM32H5_HAVE_UART8
	select STM32H5_HAVE_UART9
	select STM32H5_HAVE_USART10
	select STM32H5_HAVE_USART11
	select STM32H5_HAVE_UART12
	select STM32H5_HAVE_SPI4
	select STM32H5_HAVE_SPI5
	select STM32H5_HAVE_SPI6
	select STM32H5_HAVE_USBFS
	select STM32H5_HAVE_HSI48
	select STM32H5_HAVE_ICACHE_REMAP

config STM32H5_STM32H563XX
	# STM32H552 and STM32H562 devices documented in RM0439
	bool
	default n
	select STM32H5_HAVE_ETHERNET

choice
	prompt "Override Flash Size Designator"
	depends on ARCH_CHIP_STM32H5
	default STM32H5_FLASH_OVERRIDE_DEFAULT
	---help---
		STM32H5 series parts numbering (sans the package type) ends with a letter
		that designates the FLASH size.

			Designator  Size in KiB
				 8          64
				 B         128
				 C         256
				 E         512
				 G        1024
				 I        2048

		This configuration option defaults to using the configuration based on that designator
		or the default smaller size if there is no last character designator is present in the
		STM32 Chip Selection.

		Examples:
		   If the STM32H576VE is chosen, the Flash configuration would be 'E', if a variant of
		   the part with a 1024 KiB Flash is released in the future one could simply select
		   the 'G' designator here.

		   If an STM32H5xxx Series parts is chosen the default Flash configuration will be set
		   herein and can be changed.

config STM32H5_FLASH_OVERRIDE_DEFAULT
	bool "Default"

config STM32H5_FLASH_OVERRIDE_8
	bool "8 64 KB"

config STM32H5_FLASH_OVERRIDE_B
	bool "B 128 KB"

config STM32H5_FLASH_OVERRIDE_C
	bool "C 256 KB"

config STM32H5_FLASH_OVERRIDE_E
	bool "E 512 KB"

config STM32H5_FLASH_OVERRIDE_G
	bool "G 1024 KB"

config STM32H5_FLASH_OVERRIDE_I
	bool "I 2048 KB"

endchoice # "Override Flash Size Designator"

# Flash configurations

config STM32H5_FLASH_CONFIG_B
	bool
	default n
	depends on STM32H5_STM32H50XXX

config STM32H5_FLASH_CONFIG_C
	bool
	default n
	depends on STM32H5_STM32H52XXX

config STM32H5_FLASH_CONFIG_E
	bool
	default n
	depends on STM32H5_STM32H52XXX || STM32H5_STM32H53XXX

config STM32H5_FLASH_CONFIG_G
	bool
	default n
	depends on STM32H5_STM32H56XXX

config STM32H5_FLASH_CONFIG_I
	bool
	default n
	depends on STM32H5_STM32H56XXX || STM32H5_STM32H57XXX

# Pin/package configurations

config STM32H5_IO_CONFIG_K
	bool
	default n

config STM32H5_IO_CONFIG_T
	bool
	default n

config STM32H5_IO_CONFIG_C
	bool
	default n

config STM32H5_IO_CONFIG_R
	bool
	default n

config STM32H5_IO_CONFIG_J
	bool
	default n

config STM32H5_IO_CONFIG_M
	bool
	default n

config STM32H5_IO_CONFIG_V
	bool
	default n

config STM32H5_IO_CONFIG_Q
	bool
	default n

config STM32H5_IO_CONFIG_Z
	bool
	default n

config STM32H5_IO_CONFIG_A
	bool
	default n

comment "STM32H5 SRAM2 Options"

config STM32H5_SRAM2_HEAP
	bool "SRAM2 is used for heap"
	default n
	select STM32H5_SRAM2_INIT

config STM32H5_SRAM2_INIT
	bool "SRAM2 is initialized to zero"
	default n
	---help---
		If the SRAM2 is being used for it's battery-backed capability,
		this may be undesirable (because it will destroy the contents).  In that
		case, the board should handle the initialization itself at the appropriate
		time.

config STM32H5_PROGMEM
	bool "Flash progmem support"
	default n
	---help---
		Add progmem support, start block and end block options are provided to
		obtain a uniform flash memory mapping.

source "arch/arm/src/stm32h5/Kconfig.periph_select"

config STM32H5_FLASH_PREFETCH
	bool "Enable FLASH Pre-fetch"
	default y
	---help---
		Enable FLASH prefetch

source "arch/arm/src/stm32h5/Kconfig.icache"

config STM32H5_DISABLE_IDLE_SLEEP_DURING_DEBUG
	bool "Disable IDLE Sleep (WFI) in debug mode"
	default n
	---help---
		In debug configuration, disables the WFI instruction in the IDLE loop
		to prevent the JTAG from disconnecting.  With some JTAG debuggers, such
		as the ST-LINK2 with OpenOCD, if the ARM is put to sleep via the WFI
		instruction, the debugger will disconnect, terminating the debug session.

config ARCH_BOARD_STM32H5_CUSTOM_CLOCKCONFIG
	bool "Custom clock configuration"
	default n
	---help---
		Enables special, board-specific STM32 clock configuration.

source "arch/arm/src/stm32h5/Kconfig.spi"

source "arch/arm/src/stm32h5/Kconfig.timers"

comment "USB Device Configuration"

menu "USB Full Speed Debug Configuration"
	depends on STM32H5_USBFS

config STM32H5_USBFS_REGDEBUG
	bool "Register-Level Debug"
	default n
	depends on STM32H5_USBFS && DEBUG_USB_INFO
	---help---
		Enable very low-level register access debug.

endmenu

source "arch/arm/src/stm32h5/Kconfig.uart_config"

source "arch/arm/src/stm32h5/Kconfig.ethmac"

source "arch/arm/src/stm32h5/Kconfig.fdcan"

source "arch/arm/src/stm32h5/Kconfig.i2c"

source "arch/arm/src/stm32h5/Kconfig.qspi"

endif # ARCH_CHIP_STM32H5
```

## arch/arm/src/stm32h5/Kconfig.ethmac
```kconfig
menu "Ethernet MAC Configuration"
	depends on STM32H5_ETHMAC

config STM32H5_PHYADDR
	int "PHY address"
	default 0
	---help---
		The 5-bit address of the PHY on the board. Default: 0

config STM32H5_PHYINIT
	bool "Board-specific PHY Initialization"
	default n
	---help---
		Some boards require specialized initialization of the PHY before it can be used.
		This may include such things as configuring GPIOs, resetting the PHY, etc.
		If STM32H5_PHYINIT is defined in the configuration then the board specific logic
		must provide stm32_phyinitialize(); The STM32 Ethernet driver will call this
		function one time before it first uses the PHY.

config STM32H5_PHY_POLLING
	bool "Support network monitoring by polling the PHY"
	default n
	depends on STM32H5_HAVE_PHY_POLLED
	select ARCH_PHY_POLLED
	---help---
		Some boards may not have an interrupt connected to the PHY.
		This option allows the network monitor to be used by polling the PHY for status.

config STM32H5_MII
	bool "Use MII interface"
	default n
	---help---
		Support Ethernet MII interface.

choice
	prompt "MII clock configuration"
	default STM32H5_MII_EXTCLK
	depends on STM32H5_MII

config STM32H5_MII_MCO1
	bool "Use MC01 as MII clock"
	---help---
		Use MC01 to clock the MII interface.

config STM32H5_MII_MCO2
	bool "Use MC02 as MII clock"
	---help---
		Use MC02 to clock the MII interface.

config STM32H5_MII_EXTCLK
	bool "External MII clock"
	---help---
		Clocking is provided by external logic.

endchoice

config STM32H5_AUTONEG
	bool "Use autonegotiation"
	default y
	---help---
		Use PHY autonegotiation to determine speed and mode

config STM32H5_ETH_NRXDESC
	int "Number of RX descriptors"
	default 8
	---help---
		Number of RX DMA descriptors to use.

config STM32H5_ETH_NTXDESC
	int "Number of TX descriptors"
	default 4
	---help---
		Number of TX DMA descriptors to use.

config STM32H5_ETHFD
	bool "Full duplex"
	default n
	depends on !STM32H5_AUTONEG
	---help---
		If STM32H5_AUTONEG is not defined, then this may be defined to select full duplex
		mode. Default: half-duplex

config STM32H5_ETH100MBPS
	bool "100 Mbps"
	default n
	depends on !STM32H5_AUTONEG
	---help---
		If STM32H5_AUTONEG is not defined, then this may be defined to select 100 MBps
		speed.  Default: 10 Mbps

config STM32H5_PHYSR
	int "PHY Status Register Address (decimal)"
	depends on STM32H5_AUTONEG
	---help---
		This must be provided if STM32H5_AUTONEG is defined.  The PHY status register
		address may diff from PHY to PHY.  This configuration sets the address of
		the PHY status register.

config STM32H5_PHYSR_ALTCONFIG
	bool "PHY Status Alternate Bit Layout"
	default n
	depends on STM32H5_AUTONEG
	---help---
		Different PHYs present speed and mode information in different ways.  Some
		will present separate information for speed and mode (this is the default).
		Those PHYs, for example, may provide a 10/100 Mbps indication and a separate
		full/half duplex indication. This options selects an alternative representation
		where speed and mode information are combined.  This might mean, for example,
		separate bits for 10HD, 100HD, 10FD and 100FD.

config STM32H5_PHYSR_SPEED
	hex "PHY Speed Mask"
	depends on STM32H5_AUTONEG && !STM32H5_PHYSR_ALTCONFIG
	---help---
		This must be provided if STM32H5_AUTONEG is defined.  This provides bit mask
		for isolating the 10 or 100MBps speed indication.

config STM32H5_PHYSR_100MBPS
	hex "PHY 100Mbps Speed Value"
	depends on STM32H5_AUTONEG && !STM32H5_PHYSR_ALTCONFIG
	---help---
		This must be provided if STM32H5_AUTONEG is defined.  This provides the value
		of the speed bit(s) indicating 100MBps speed.

config STM32H5_PHYSR_MODE
	hex "PHY Mode Mask"
	depends on STM32H5_AUTONEG && !STM32H5_PHYSR_ALTCONFIG
	---help---
		This must be provided if STM32H5_AUTONEG is defined.  This provide bit mask
		for isolating the full or half duplex mode bits.

config STM32H5_PHYSR_FULLDUPLEX
	hex "PHY Full Duplex Mode Value"
	depends on STM32H5_AUTONEG && !STM32H5_PHYSR_ALTCONFIG
	---help---
		This must be provided if STM32H5_AUTONEG is defined.  This provides the
		value of the mode bits indicating full duplex mode.

config STM32H5_PHYSR_ALTMODE
	hex "PHY Mode Mask"
	depends on STM32H5_AUTONEG && STM32H5_PHYSR_ALTCONFIG
	---help---
		This must be provided if STM32H5_AUTONEG is defined.  This provide bit mask
		for isolating the speed and full/half duplex mode bits.

config STM32H5_PHYSR_10HD
	hex "10MBase-T Half Duplex Value"
	depends on STM32H5_AUTONEG && STM32H5_PHYSR_ALTCONFIG
	---help---
		This must be provided if STM32H5_AUTONEG is defined.  This is the value
		under the bit mask that represents the 10Mbps, half duplex setting.

config STM32H5_PHYSR_100HD
	hex "100Base-T Half Duplex Value"
	depends on STM32H5_AUTONEG && STM32H5_PHYSR_ALTCONFIG
	---help---
		This must be provided if STM32H5_AUTONEG is defined.  This is the value
		under the bit mask that represents the 100Mbps, half duplex setting.

config STM32H5_PHYSR_10FD
	hex "10Base-T Full Duplex Value"
	depends on STM32H5_AUTONEG && STM32H5_PHYSR_ALTCONFIG
	---help---
		This must be provided if STM32H5_AUTONEG is defined.  This is the value
		under the bit mask that represents the 10Mbps, full duplex setting.

config STM32H5_PHYSR_100FD
	hex "100Base-T Full Duplex Value"
	depends on STM32H5_AUTONEG && STM32H5_PHYSR_ALTCONFIG
	---help---
		This must be provided if STM32H5_AUTONEG is defined.  This is the value
		under the bit mask that represents the 100Mbps, full duplex setting.

config STM32H5_ETH_PTP
	bool "Precision Time Protocol (PTP)"
	default n
	---help---
		Precision Time Protocol (PTP).  Not supported but some hooks are indicated
		with this condition.

config STM32H5_RMII
	bool
	default !STM32H5_MII

choice
	prompt "RMII clock configuration"
	default STM32H5_RMII_EXTCLK
	depends on STM32H5_RMII

config STM32H5_RMII_MCO1
	bool "Use MC01 as RMII clock"
	---help---
		Use MCO1 to clock the RMII interface.

config STM32H5_RMII_MCO2
	bool "Use MC02 as RMII clock"
	---help---
		Use MCO2 to clock the RMII interface.

config STM32H5_RMII_EXTCLK
	bool "External RMII clock"
	---help---
		Clocking is provided by external logic.

endchoice # RMII clock configuration

config STM32H5_ETHMAC_REGDEBUG
	bool "Register-Level Debug"
	default n
	depends on DEBUG_NET_INFO
	---help---
		Enable very low-level register access debug.  Depends on
		CONFIG_DEBUG_FEATURES.

config STM32H5_NO_PHY
	bool "MAC has no PHY"
	default n

endmenu # Ethernet MAC Configuration
```
