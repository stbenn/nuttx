## arch/arm/src/stm32h5/Kconfig.periph_select
```kconfig
comment "STM32H5 Peripherals"

menu "STM32H5 Peripheral Selection"

# These "hidden" settings determine if a peripheral option is available
# for the selected MCU


config STM32H5_HAVE_ETHERNET
	bool
	default n

config STM32H5_HAVE_PHY_POLLED
	bool
	default n

config STM32H5_HAVE_FDCAN1
	bool
	default n

config STM32H5_HAVE_FDCAN2
	bool
	default n

config STM32H5_HAVE_HSI48
	bool
	default n

config STM32H5_HAVE_ICACHE
	bool
	default n

config STM32H5_HAVE_LPUART1
	bool
	default n

config STM32H5_HAVE_SPI5
	bool
	default n

config STM32H5_HAVE_SPI6
	bool
	default n

config STM32H5_HAVE_USART1
	bool
	default n

config STM32H5_HAVE_USART2
	bool
	default n

config STM32H5_HAVE_USART3
	bool
	default n

config STM32H5_HAVE_UART4
	bool
	default n

config STM32H5_HAVE_UART5
	bool
	default n

config STM32H5_HAVE_USART6
	bool
	default n

config STM32H5_HAVE_UART7
	bool
	default n

config STM32H5_HAVE_UART8
	bool
	default n

config STM32H5_HAVE_UART9
	bool
	default n

config STM32H5_HAVE_USART10
	bool
	default n

config STM32H5_HAVE_USART11
	bool
	default n

config STM32H5_HAVE_UART12
	bool
	default n

config STM32H5_HAVE_USBFS
	bool
	default n

# These "hidden" settings are the OR of individual peripheral selections
# indicating that the general capability is required.

config STM32H5_USART
	bool
	default n

config STM32H5_ADC
	bool
	default n

config STM32H5_SPI
	bool
	default n

config STM32H5_SPI_DMA
	bool
	default n

config STM32H5_TIM
	bool
	default n

# These are the peripheral selections proper

config STM32H5_ADC1
	bool "ADC1"
	default n
	select STM32H5_ADC

config STM32H5_ADC2
	bool "ADC2"
	default n
	select STM32H5_ADC

config STM32H5_ETHMAC
	bool "Ethernet MAC"
	default n
	depends on STM32H5_HAVE_ETHERNET
	select NETDEVICES
	select ARCH_HAVE_PHY
	select STM32H5_HAVE_PHY_POLLED

config STM32H5_ICACHE
	bool "ICACHE"
	default n
	depends on STM32H5_HAVE_ICACHE

config STM32H5_QSPI1
	bool "QSPI1"
	default n

config STM32H5_USART2
	bool "USART2"
	default n
	depends on STM32H5_HAVE_USART2
	select ARCH_HAVE_SERIAL_TERMIOS
	select STM32H5_USART

config STM32H5_USART3
	bool "USART3"
	default n
	depends on STM32H5_HAVE_USART3
	select ARCH_HAVE_SERIAL_TERMIOS
	select STM32H5_USART

config STM32H5_UART4
	bool "UART4"
	default n
	depends on STM32H5_HAVE_UART4
	select ARCH_HAVE_SERIAL_TERMIOS
	select STM32H5_USART

config STM32H5_UART5
	bool "UART5"
	default n
	depends on STM32H5_HAVE_UART5
	select ARCH_HAVE_SERIAL_TERMIOS
	select STM32H5_USART

config STM32H5_USART6
	bool "USART6"
	default n
	depends on STM32H5_HAVE_USART6
	select ARCH_HAVE_SERIAL_TERMIOS
	select STM32H5_USART

config STM32H5_UART7
	bool "UART7"
	default n
	depends on STM32H5_HAVE_UART7
	select ARCH_HAVE_SERIAL_TERMIOS
	select STM32H5_USART

config STM32H5_UART8
	bool "UART8"
	default n
	depends on STM32H5_HAVE_UART8
	select ARCH_HAVE_SERIAL_TERMIOS
	select STM32H5_USART

config STM32H5_USART10
	bool "USART10"
	default n
	depends on STM32H5_HAVE_USART10
	select ARCH_HAVE_SERIAL_TERMIOS
	select STM32H5_USART

config STM32H5_USART11
	bool "USART11"
	default n
	depends on STM32H5_HAVE_USART11
	select ARCH_HAVE_SERIAL_TERMIOS
	select STM32H5_USART

config STM32H5_UART9
	bool "UART9"
	default n
	depends on STM32H5_HAVE_UART9
	select ARCH_HAVE_SERIAL_TERMIOS
	select STM32H5_USART

config STM32H5_UART12
	bool "UART12"
	default n
	depends on STM32H5_HAVE_UART12
	select ARCH_HAVE_SERIAL_TERMIOS
	select STM32H5_USART

config STM32H5_USART1
	bool "USART1"
	default n
	depends on STM32H5_HAVE_USART1
	select ARCH_HAVE_SERIAL_TERMIOS
	select STM32H5_USART

config STM32H5_LPUART1
	bool "LPUART1"
	default n
	depends on STM32H5_HAVE_LPUART1
	select ARCH_HAVE_SERIAL_TERMIOS
	select STM32H5_USART

config STM32H5_I2C
	bool
	default n

config STM32H5_I2C1
	bool "I2C1"
	default n
	select STM32H5_I2C

config STM32H5_I2C2
	bool "I2C2"
	default n
	select STM32H5_I2C

config STM32H5_I2C3
	bool "I2C3"
	default n
	select STM32H5_I2C

config STM32H5_I2C4
	bool "I2C4"
	default n
	select STM32H5_I2C

config STM32H5_SPI1
	bool "SPI1"
	default n
	select SPI
	select STM32H5_SPI

config STM32H5_SPI2
	bool "SPI2"
	default n
	select SPI
	select STM32H5_SPI

config STM32H5_SPI3
	bool "SPI3"
	default n
	select SPI
	select STM32H5_SPI

config STM32H5_SPI4
	bool "SPI4"
	default n
	depends on STM32H5_HAVE_SPI4
	select SPI
	select STM32H5_SPI

config STM32H5_SPI5
	bool "SPI5"
	default n
	depends on STM32H5_HAVE_SPI5
	select SPI
	select STM32H5_SPI

config STM32H5_SPI6
	bool "SPI6"
	default n
	depends on STM32H5_HAVE_SPI6
	select SPI
	select STM32H5_SPI

menu "STM32H5 Timer Selection"

config STM32H5_TIM1
	bool "TIM1"
	default n
	select STM32H5_TIM

config STM32H5_TIM2
	bool "TIM2"
	default n
	select STM32H5_TIM

config STM32H5_TIM3
	bool "TIM3"
	default n
	select STM32H5_TIM

config STM32H5_TIM4
	bool "TIM4"
	default n
	select STM32H5_TIM

config STM32H5_TIM5
	bool "TIM5"
	default n
	select STM32H5_TIM

config STM32H5_TIM6
	bool "TIM6"
	default n
	select STM32H5_TIM

config STM32H5_TIM7
	bool "TIM7"
	default n
	select STM32H5_TIM

config STM32H5_TIM8
	bool "TIM8"
	default n
	select STM32H5_TIM

config STM32H5_TIM12
	bool "TIM12"
	default n
	select STM32H5_TIM

config STM32H5_TIM13
	bool "TIM13"
	default n
	select STM32H5_TIM

config STM32H5_TIM14
	bool "TIM14"
	default n
	select STM32H5_TIM

config STM32H5_TIM15
	bool "TIM15"
	default n
	select STM32H5_TIM

config STM32H5_TIM16
	bool "TIM16"
	default n
	select STM32H5_TIM

config STM32H5_TIM17
	bool "TIM17"
	default n
	select STM32H5_TIM

endmenu # STM32H5 Timer Selection

config STM32H5_USBFS
	bool "USB Device"
	default n
	depends on STM32H5_HAVE_USBFS
	select USBDEV

endmenu
```

## arch/arm/src/stm32h5/Kconfig.qspi
```kconfig
menu "QuadSPI Configuration"
	depends on STM32H5_QSPI1

config STM32H5_QSPI_FLASH_SIZE
	int "Size of attached serial flash, bytes"
	default 16777216
	range 1 2147483648
	---help---
		The STM32H5 QSPI peripheral requires the size of the Flash be specified

config STM32H5_QSPI_FIFO_THESHOLD
	int "Number of bytes before asserting FIFO threshold flag"
	default 4
	range 1 32
	---help---
		The STM32H5 QSPI peripheral requires that the FIFO threshold be specified
		I would leave it at the default value of 4 unless you know what you are doing.

config STM32H5_QSPI_CSHT
	int "Number of cycles Chip Select must be inactive between transactions"
	default 5
	range 1 64
	---help---
		The STM32H5 QSPI peripheral requires that it be specified the minimum number
		of AHB cycles that Chip Select be held inactive between transactions.

choice
	prompt "Transfer technique"
	default STM32H5_QSPI_DMA
	---help---
		You can choose between using polling, interrupts, or DMA to transfer data
		over the QSPI interface.

config STM32H5_QSPI_POLLING
	bool "Polling"
	---help---
		Use conventional register I/O with status polling to transfer data.

config STM32H5_QSPI_INTERRUPTS
	bool "Interrupts"
	---help---
		User interrupt driven I/O transfers.

config STM32H5_QSPI_DMA
	bool "DMA"
	depends on STM32H5_DMA
	---help---
		Use DMA to improve QSPI transfer performance.

endchoice

choice
	prompt "Bank selection"
	default STM32H5_QSPI_MODE_BANK1
	---help---
		You can choose between using polling, interrupts, or DMA to transfer data
		over the QSPI interface.

config STM32H5_QSPI_MODE_BANK1
	bool "Bank 1"

config STM32H5_QSPI_MODE_BANK2
	bool "Bank 2"

config STM32H5_QSPI_MODE_DUAL
	bool "Dual Bank"

endchoice

choice
	prompt "DMA Priority"
	default STM32H5_QSPI_DMAPRIORITY_MEDIUM
	depends on STM32H5_DMA
	---help---
		The DMA controller supports priority levels.  You are probably fine
		with the default of 'medium' except for special cases.  In the event
		of contention between to channels at the same priority, the lower
		numbered channel has hardware priority over the higher numbered one.

config STM32H5_QSPI_DMAPRIORITY_VERYHIGH
	bool "Very High priority"
	depends on STM32H5_DMA
	---help---
		'Highest' priority.

config STM32H5_QSPI_DMAPRIORITY_HIGH
	bool "High priority"
	depends on STM32H5_DMA
	---help---
		'High' priority.

config STM32H5_QSPI_DMAPRIORITY_MEDIUM
	bool "Medium priority"
	depends on STM32H5_DMA
	---help---
		'Medium' priority.

config STM32H5_QSPI_DMAPRIORITY_LOW
	bool "Low priority"
	depends on STM32H5_DMA
	---help---
		'Low' priority.

endchoice

config STM32H5_QSPI_DMATHRESHOLD
	int "QSPI DMA threshold"
	default 4
	depends on STM32H5_QSPI_DMA
	---help---
		When QSPI DMA is enabled, small DMA transfers will still be performed
		by polling logic.  This value is the threshold below which transfers
		will still be performed by conventional register status polling.

config STM32H5_QSPI_DMADEBUG
	bool "QSPI DMA transfer debug"
	depends on STM32H5_QSPI_DMA && DEBUG_SPI && DEBUG_DMA
	default n
	---help---
		Enable special debug instrumentation to analyze QSPI DMA data transfers.
		This logic is as non-invasive as possible:  It samples DMA
		registers at key points in the data transfer and then dumps all of
		the registers at the end of the transfer.

config STM32H5_QSPI_REGDEBUG
	bool "QSPI Register level debug"
	depends on DEBUG_SPI_INFO
	default n
	---help---
		Output detailed register-level QSPI device debug information.
		Requires also CONFIG_DEBUG_SPI_INFO.

endmenu # QuadSPI Configuration
```

## arch/arm/src/stm32h5/Kconfig.spi
```kconfig
menu "SPI Configuration"
	depends on STM32H5_SPI

config STM32H5_SPI_INTERRUPTS
	bool "Interrupt driver SPI"
	default n
	---help---
		Select to enable interrupt driven SPI support. Non-interrupt-driven,
		poll-waiting is recommended if the interrupt rate would be too high in
		the interrupt driven case.

config STM32H5_SPI_DMATHRESHOLD
	int "SPI DMA threshold"
	default 4
	depends on STM32H5_SPI_DMA
	---help---
		When SPI DMA is enabled, small DMA transfers will still be performed
		by polling logic.  But we need a threshold value to determine what
		is small.

config STM32H5_SPI1_DMA
	bool "SPI1 DMA"
	default n
	depends on STM32H5_SPI1 && !STM32H5_SPI_INTERRUPT
	select STM32H5_SPI_DMA
	---help---
		Use DMA to improve SPI1 transfer performance.  Cannot be used with STM32H5_SPI_INTERRUPT

config STM32H5_SPI1_DMA_BUFFER
	int "SPI1 DMA buffer size"
	default 0
	depends on STM32H5_SPI1_DMA
	---help---
		Add a properly aligned DMA buffer for RX and TX DMA for SPI1.

config STM32H5_SPI1_COMMTYPE
	int "SPI1 Operation mode"
	default 0
	range 0 3
	depends on STM32H5_SPI1
	---help---
		Select full-duplex (0), simplex tx (1), simplex rx (2) or half-duplex (3)

config STM32H5_SPI2_DMA
	bool "SPI2 DMA"
	default n
	depends on STM32H5_SPI2 && !STM32H5_SPI_INTERRUPT
	select STM32H5_SPI_DMA
	---help---
		Use DMA to improve SPI2 transfer performance.  Cannot be used with STM32H5_SPI_INTERRUPT

config STM32H5_SPI2_DMA_BUFFER
	int "SPI2 DMA buffer size"
	default 0
	depends on STM32H5_SPI2_DMA
	---help---
		Add a properly aligned DMA buffer for RX and TX DMA for SPI2.

config STM32H5_SPI2_COMMTYPE
	int "SPI2 Operation mode"
	default 0
	range 0 3
	depends on STM32H5_SPI2
	---help---
		Select full-duplex (0), simplex tx (1), simplex rx (2) or half-duplex (3)

config STM32H5_SPI3_DMA
	bool "SPI3 DMA"
	default n
	depends on STM32H5_SPI3 && !STM32H5_SPI_INTERRUPT
	select STM32H5_SPI_DMA
	---help---
		Use DMA to improve SPI3 transfer performance.  Cannot be used with STM32H5_SPI_INTERRUPT

config STM32H5_SPI3_DMA_BUFFER
	int "SPI3 DMA buffer size"
	default 0
	depends on STM32H5_SPI3_DMA
	---help---
		Add a properly aligned DMA buffer for RX and TX DMA for SPI3.

config STM32H5_SPI3_COMMTYPE
	int "SPI3 Operation mode"
	default 0
	range 0 3
	depends on STM32H5_SPI3
	---help---
		Select full-duplex (0), simplex tx (1), simplex rx (2) or half-duplex (3)

config STM32H5_SPI4_DMA
	bool "SPI4 DMA"
	default n
	depends on STM32H5_SPI4 && !STM32H5_SPI_INTERRUPT
	select STM32H5_SPI_DMA
	---help---
		Use DMA to improve SPI4 transfer performance.  Cannot be used with STM32H5_SPI_INTERRUPT

config STM32H5_SPI4_DMA_BUFFER
	int "SPI4 DMA buffer size"
	default 0
	depends on STM32H5_SPI4_DMA
	---help---
		Add a properly aligned DMA buffer for RX and TX DMA for SPI4.

config STM32H5_SPI4_COMMTYPE
	int "SPI4 Operation mode"
	default 0
	range 0 3
	depends on STM32H5_SPI4
	---help---
		Select full-duplex (0), simplex tx (1), simplex rx (2) or half-duplex (3)

config STM32H5_SPI5_DMA
	bool "SPI5 DMA"
	default n
	depends on STM32H5_SPI5 && !STM32H5_SPI_INTERRUPT
	select STM32H5_SPI_DMA
	---help---
		Use DMA to improve SPI5 transfer performance.  Cannot be used with STM32H5_SPI_INTERRUPT

config STM32H5_SPI5_DMA_BUFFER
	int "SPI5 DMA buffer size"
	default 0
	depends on STM32H5_SPI5_DMA
	---help---
		Add a properly aligned DMA buffer for RX and TX DMA for SPI5.

config STM32H5_SPI5_COMMTYPE
	int "SPI5 Operation mode"
	default 0
	range 0 3
	depends on STM32H5_SPI5
	---help---
		Select full-duplex (0), simplex tx (1), simplex rx (2) or half-duplex (3)

config STM32H5_SPI6_DMA
	bool "SPI6 DMA"
	default n
	depends on STM32H5_SPI6 && !STM32H5_SPI_INTERRUPT
	select STM32H5_SPI_DMA
	---help---
		Use DMA to improve SPI6 transfer performance.  Cannot be used with STM32H5_SPI_INTERRUPT

config STM32H5_SPI6_DMA_BUFFER
	int "SPI6 DMA buffer size"
	default 0
	depends on STM32H5_SPI6_DMA
	---help---
		Add a properly aligned DMA buffer for RX and TX DMA for SPI6.

config STM32H5_SPI6_COMMTYPE
	int "SPI6 Operation mode"
	default 0
	range 0 3
	depends on STM32H5_SPI6
	---help---
		Select full-duplex (0), simplex tx (1), simplex rx (2) or half-duplex (3)

endmenu # "SPI Configuration"
```
